## nRF53/build/Kconfig/arch/Kconfig
```kconfig
# Load Zephyr Arch Kconfig descriptions.
osource "/home/mlorenc/ncs/v3.2.4/zephyr/arch/rx/Kconfig"
osource "/home/mlorenc/ncs/v3.2.4/zephyr/arch/x86/Kconfig"
osource "/home/mlorenc/ncs/v3.2.4/zephyr/arch/xtensa/Kconfig"
osource "/home/mlorenc/ncs/v3.2.4/zephyr/arch/sparc/Kconfig"
osource "/home/mlorenc/ncs/v3.2.4/zephyr/arch/riscv/Kconfig"
osource "/home/mlorenc/ncs/v3.2.4/zephyr/arch/posix/Kconfig"
osource "/home/mlorenc/ncs/v3.2.4/zephyr/arch/mips/Kconfig"
osource "/home/mlorenc/ncs/v3.2.4/zephyr/arch/arm64/Kconfig"
osource "/home/mlorenc/ncs/v3.2.4/zephyr/arch/arm/Kconfig"
osource "/home/mlorenc/ncs/v3.2.4/zephyr/arch/arc/Kconfig"
```

## nRF53/build/mqtt/Kconfig/boards/Kconfig.defconfig
```kconfig
# Load Zephyr board defconfig descriptions.
osource "/home/mlorenc/ncs/v3.2.4/zephyr/boards/nordic/nrf5340dk/Kconfig.defconfig"
```

## nRF53/build/mqtt/Kconfig/boards/Kconfig.nrf5340dk
```kconfig
# Load board Kconfig descriptions.
osource "/home/mlorenc/ncs/v3.2.4/zephyr/boards/nordic/nrf5340dk/Kconfig.nrf5340dk"
```
